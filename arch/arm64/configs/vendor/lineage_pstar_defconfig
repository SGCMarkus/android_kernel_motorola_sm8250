## arch/arm64/configs/vendor/lineage_pstar_defconfig
```kconfig
# Moto sm8250 common
CONFIG_MMI_DEVICE_DTBS=y
CONFIG_BUILD_ARM64_DT_OVERLAY=y
CONFIG_CPU_FREQ_STAT=y
CONFIG_INIT_STACK_ALL_ZERO=y
CONFIG_INIT_ON_ALLOC_DEFAULT_ON=y
CONFIG_JUMP_LABEL=y
CONFIG_USB_NET_MCS7830=y
CONFIG_USB_UAS=y
CONFIG_SDCARD_FS_PARTIAL_RELATIME="/%s/Download:com.motorola.mya"
CONFIG_SDCARD_FS_DIR_WRITER="/%s/%s"
CONFIG_HZ_300=y
CONFIG_USB_CONFIGFS_ACM=y
CONFIG_BUG_ON_DATA_CORRUPTION=y
# CONFIG_RSEQ is not set
CONFIG_SCHED_STACK_END_CHECK=y
# CONFIG_SLUB_DEBUG is not set
CONFIG_ION_SYSTEM_HEAP=y
CONFIG_WATCHDOG=y
CONFIG_SOFT_WATCHDOG=y
CONFIG_SONY_FF=y

# Haptic
CONFIG_INPUT_AWINIC_HAPTIC=y
CONFIG_AW8695_HAPTIC=m

# Camera additions
CONFIG_CAMERA_CCI_INTF=m

# ETS FPS
CONFIG_FINGERPRINT_EGISTEC_FPS_MMI=m
CONFIG_INPUT_EGISTEC_FPS_NAVI=y
CONFIG_INPUT_EGISTEC_FPS_NAVI_HORIZON=y
CONFIG_INPUT_EGISTEC_FPS_NAVI_VERTICAL=y
CONFIG_NAV_DOUBLE_TAP=y
#? CONFIG_EGIS_DISPLAY_SPEED_UP=y

# FPC FPS
CONFIG_FINGERPRINT_FPC_TEE_MMI=m
CONFIG_INPUT_MISC_FPC1020_SAVE_TO_CLASS_DEVICE=y

# Goodix fod
CONFIG_FINGERPRINT_GOODIX_FOD_MMI=m

# Exfat
CONFIG_EXFAT_FS=m

# TOF
CONFIG_INPUT_STMVL53L1=m
# CONFIG_INPUT_MISC_PMIC_WL2864C=y
# CONFIG_INPUT_MISC_TOF_USE_VL53L3=y

# Touch 
CONFIG_INPUT_TOUCHSCREEN_MMI=m
CONFIG_DRM_DYNAMIC_REFRESH_RATE=y
# CONFIG_DRM_PANEL_NOTIFICATIONS is not set

# MMI annotate
CONFIG_MMI_ANNOTATE=m

# MMI info
CONFIG_MMI_INFO=m

# Moto usb
CONFIG_MOTO_F_USBNET=m

# MMI sys temp
CONFIG_MMI_SYS_TEMP=m

# qpnp power on mmi
CONFIG_INPUT_QPNP_POWER_ON_MMI=m

# Power
CONFIG_QPNP_SMBCHARGER_MMI=m
CONFIG_QPNP_ADAPTIVE_CHARGE=m

# Sensors
CONFIG_SENSORS_CLASS=m

# Regulators
CONFIG_REGULATOR_SLG51000=m

# Tz dump
CONFIG_TZLOG_DUMP=m

# Watchdog
CONFIG_WATCHDOG_CPU_CTX=m
CONFIG_WATCHDOGTEST=m

# utags
CONFIG_MOTO_UTAGS=m

# -------- Pstar ---------
CONFIG_PSTAR_DTB=y
CONFIG_PSTORE=y
CONFIG_PSTORE_CONSOLE=y
CONFIG_PSTORE_RAM=y
CONFIG_PSTORE_PMSG=y
CONFIG_PANEL_NOTIFICATIONS=y
CONFIG_CRYPTO_LZ4=y
CONFIG_FS_ENCRYPTION_INLINE_CRYPT=y
CONFIG_UFSHPB_TOSHIBA=y
CONFIG_UFSHPB_31=y
CONFIG_UFSFEATURE_31=y
CONFIG_UFSTW_31=y
CONFIG_FS_HPB=y
CONFIG_UFSTW_BOOT_ENABLED=y
CONFIG_UFSTW_IGNORE_GUARANTEE_BIT_31=y
CONFIG_SUSPEND_SKIP_SYNC=y
CONFIG_AF_NOISE_ELIMINATION=y
CONFIG_ZRAM_WRITEBACK=y
CONFIG_QCOM_FSA4480_I2C=y
CONFIG_USB_REDRIVER_PS5169=y
CONFIG_USB_F_UVC=y
CONFIG_QCOM_FSA4480_LPD=y
CONFIG_QC3P_PUMP_SUPPORT=y

# Touch
CONFIG_TOUCHSCREEN_ST=n
CONFIG_TOUCHSCREEN_FTS_TS=m

# Power
CONFIG_BQ2597X_MMI=m
CONFIG_BQ2597X_DUAL=y
CONFIG_MMI_PARALLEL_CHARGER=m
CONFIG_MMI_PARALLEL_CHARGER_QC3P=m

# MMI relay
CONFIG_MMI_RELAY=m

# NFC
CONFIG_NFC=y
CONFIG_NFC_ST21NFC=m

# SAR
CONFIG_SARSENSOR_SX937X=m

# Regulator
CONFIG_REGULATOR_WL2866D=m

# Wlan
CONFIG_QCA_CLD_WLAN=m
CONFIG_QCA_CLD_WLAN_PROFILE="qca6390"

# RMNET
CONFIG_RMNET_PERF=m
CONFIG_RMNET_SHS=m
```

## drivers/input/fingerprint/ets_fps_mmi/Kconfig
```kconfig
config FINGERPRINT_EGISTEC_FPS_MMI
	tristate "EGISTEC FPS support"

config INPUT_EGISTEC_FPS_NAVI
	bool "EGISTEC FPS navigation support"
	depends on FINGERPRINT_EGISTEC_FPS_MMI

config INPUT_EGISTEC_FPS_NAVI_HORIZON
	bool "EGISTEC FPS horizontal navigation support"
	depends on INPUT_EGISTEC_FPS_NAVI

config INPUT_EGISTEC_FPS_NAVI_VERTICAL
	bool "EGISTEC FPS vertical navigation support"
	depends on INPUT_EGISTEC_FPS_NAVI

config INPUT_EGISTEC_FPS_POSE
	int "EGISTEC FPS orientation"
	depends on INPUT_EGISTEC_FPS_NAVI
	default 270
	help
		"Supported values: 0, 90, 180, 270"

config NAV_DOUBLE_TAP
	bool "EGISTEC FPS double tap support"
	depends on INPUT_EGISTEC_FPS_NAVI

config EGIS_DISPLAY_SPEED_UP
	bool "EGISTEC FPS display speed up"
	depends on FINGERPRINT_EGISTEC_FPS_MMI
```

## drivers/input/fingerprint/fpc_fps_mmi/Kconfig
```kconfig
config FINGERPRINT_FPC_TEE_MMI
	tristate "FPC1020 Fingerprint sensor device driver"

config INPUT_MISC_FPC1020_SAVE_TO_CLASS_DEVICE
	bool "FPC1020 save to class device"
	depends on FINGERPRINT_FPC_TEE_MMI
```

## drivers/input/touchscreen/nova_0flash_mmi/Kconfig
```kconfig
#
# Novatek NT36xxx touchscreen driver configuration
#
config TOUCHSCREEN_NT36xxx_HOSTDL_SPI_MMI
	tristate "Moto Novatek NT36xxx host download SPI driver"
	depends on SPI
	default n
	help
	  Say Y here if you have a Moto Novatek NT36xxx no flash touchscreen connected
	  to your system by SPI bus.

	  If unsure, say N.

config INPUT_NOVA_0FLASH_MMI_ENABLE_DOUBLE_TAP
	bool "Moto Novatek NT36xxx Doubel tap"
	depends on TOUCHSCREEN_NT36xxx_HOSTDL_SPI_MMI
	default n
	help
	  Say Y here if you want to have Double tap support on Moto Novatek NT36xxx.

	  If unsure, say N.

config INPUT_NOVA_PANEL_NOTIFICATIONS
	bool "Moto Novatek NT36xxx panel notification"
	depends on TOUCHSCREEN_NT36xxx_HOSTDL_SPI_MMI
	default n
	help
	  Say Y here if you want to have panel notification support on Moto Novatek NT36xxx.

	  If unsure, say N.

config INPUT_NOVA_PANEL_ESD_ENABLE
    bool "Moto Novatek NT36xxx ESD Detection"
    depends on TOUCHSCREEN_NT36xxx_HOSTDL_SPI_MMI
    default n
    help
      Say Y here if you want to have ESD Detection support on Moto Novatek NT36xxx.

      If unsure, say N.

config INPUT_NOVA_0FLASH_MMI_ENABLE_DOUBLE_TAP
	bool "Moto Novatek NT36xxx double tap"
	depends on TOUCHSCREEN_NT36xxx_HOSTDL_SPI_MMI

config INPUT_NOVA_0FLASH_MMI_NOTIFY_TOUCH_STATE
	bool "Moto Novatek NT36xxx touch state"
	depends on TOUCHSCREEN_NT36xxx_HOSTDL_SPI_MMI

config INPUT_NOVA_0FLASH_MMI_DRM_PANEL
	bool "Moto Novatek NT36xxx drm panel"
	depends on TOUCHSCREEN_NT36xxx_HOSTDL_SPI_MMI

config INPUT_NOVA_CHIP_VER_1
	bool "Moto Novatek NT36xxx chip version 1"
	depends on TOUCHSCREEN_NT36xxx_HOSTDL_SPI_MMI

config INPUT_NOVA_LCM_FAST_LIGHTUP
	bool "Moto Novatek NT36xxx fast lightup"
	depends on TOUCHSCREEN_NT36xxx_HOSTDL_SPI_MMI

config INPUT_NOVA_0FLASH_MMI_STYLUS_PALM
	bool "Moto Novatek NT36xxx stylus palm"
	depends on TOUCHSCREEN_NT36xxx_HOSTDL_SPI_MMI

config INPUT_NOVA_0FLASH_MMI_STYLUS_PALM_RANGE
	bool "Moto Novatek NT36xxx stylus palm range"
	depends on TOUCHSCREEN_NT36xxx_HOSTDL_SPI_MMI

config INPUT_NOVA_0FLASH_MMI_PEN_NOTIFIER
	bool "Moto Novatek NT36xxx pen notifier"
	depends on TOUCHSCREEN_NT36xxx_HOSTDL_SPI_MMI

config INPUT_NOVA_EDGE_SUPPRESSION
	bool "Moto Novatek NT36xxx edge suppression"
	depends on TOUCHSCREEN_NT36xxx_HOSTDL_SPI_MMI
```

## drivers/misc/awinic/aw8695/Kconfig
```kconfig
#
# AW8695 Driver
#

config AW8695_HAPTIC
	tristate "Awinic AW8695 haptic driver"
	depends on I2C && INPUT_AWINIC_HAPTIC
	help
	  Say Y here if you have Awinic AW8695 haptic controller
	  chip in your system.

	  If unsure, say N.

	  To compile this driver as a module, choose M here: the
	  module will be called aw8695.

if AW8695_HAPTIC

config AF_NOISE_ELIMINATION
	bool "Moto awinic auto focus noise elimination"
	default n
	help
	 Say Y here if you wish to include support for Moto awinic autofocus noise elimination.
	 If unsure, say N.

config AW8965_VIBRATOR_SHORT_WAV_ENABLE
	bool "Moto awinic short wav support"
	default n
	help
	 Say Y here if you wish to include support for Moto awinic short wav.
	 If unsure, say N.

endif
```

## drivers/power/bq2597x_mmi/Kconfig
```kconfig
config BQ2597X_MMI
        tristate "BQ2597X MMI charger"
        default n
        help
         Say Y here if you have a BQ2597X MMI charger compatible
         device connected.

         This driver can also be built as a module.  If so, the module
         will be called bq2597x_mmi.

config BQ2597X_DUAL
	bool "BQ2597X dual support"
	default n
	depends on BQ2597X_MMI
	help
         Say Y here if you have a BQ2597X dual support charger compatible
         device connected.
```

## drivers/power/p938x_charger/Kconfig
```kconfig
config P938X_CHARGER
        tristate "P938X CHARGER"
        default n
        help
         Say Y here if you have a p938x charger compatible
         device connected.

         This driver can also be built as a module.  If so, the module
         will be called p938x_charger.
```

## drivers/power/qpnp-smbcharger-mmi/Kconfig
```kconfig
config QPNP_SMBCHARGER_MMI
        tristate "QPNP SMBCHARGER MMI"
        default n
        help
         Say Y here if you have a qpnp smbcharger mmi compatible
         device connected.

         This driver can also be built as a module.  If so, the module
         will be called qpnp_smbcharger_mmi.

config CONFIG_PD_CHARGER_MMI
		bool "QPNP SMBCHARGER PD charger"
		depends on QPNP_SMBCHARGER_MMI
```
